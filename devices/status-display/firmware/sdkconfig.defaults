## devices/status-display/firmware/sdkconfig.defaults
```kconfig
CONFIG_PARTITION_TABLE_CUSTOM=y
CONFIG_PARTITION_TABLE_CUSTOM_FILENAME="/home/aleks/work/projects/home_assist/repo/devices/status-display/firmware/partitions.csv"
CONFIG_ESPTOOLPY_FLASHSIZE_4MB=y
CONFIG_ESP_MAIN_TASK_STACK_SIZE=32768
CONFIG_PTHREAD_TASK_STACK_SIZE_DEFAULT=8192
CONFIG_LWIP_MAX_SOCKETS=16
CONFIG_ESP_TASK_WDT_TIMEOUT_S=30
```
